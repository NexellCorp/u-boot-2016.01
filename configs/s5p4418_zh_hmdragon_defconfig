## configs/s5p4418_zh_hmdragon_defconfig
```kconfig
CONFIG_ARM=y
CONFIG_SYS_CONFIG_NAME="s5p4418_zh_hmdragon"
CONFIG_ARCH_NEXELL=y
CONFIG_ARCH_S5P4418=y
CONFIG_CPU_NXP4330=y
CONFIG_TARGET_S5P4418_ZH_HMDRAGON=y
CONFIG_DM_I2C=y
CONFIG_DM_GPIO=y
CONFIG_DEFAULT_DEVICE_TREE="s5p4418-zh-hmdragon"
CONFIG_FIT=y
CONFIG_CMD_USB=y
CONFIG_CMD_FDISK=y
CONFIG_CMD_EXT4_IMG_WRITE=y
CONFIG_CMD_CHECK_HW=y
CONFIG_OF_CONTROL=y
CONFIG_OF_EMBED=y
CONFIG_DM=y
CONFIG_NX_GPIO=y
CONFIG_DM_I2C_GPIO=y
CONFIG_SYS_I2C_NEXELL=y
CONFIG_USB_CHARGE=y
CONFIG_MISC=y
CONFIG_USB=y
CONFIG_DM_USB=y
CONFIG_USB_EHCI_HCD=y
CONFIG_DISPLAY_PORT=y
CONFIG_VIDEO_NX=y
CONFIG_VIDEO_NX_HDMI=y
CONFIG_ERRNO_STR=y
# CONFIG_CMD_IMI is not set                                                     
# CONFIG_CMD_IMLS is not set                                                    
# CONFIG_CMD_FLASH is not set         
# CONFIG_CMD_FPGA is not set                                                    
# CONFIG_CMD_NET is not set                                                     
# CONFIG_CMD_NFS is not set                                                     
```

## configs/s5p6818_arm64_drone_defconfig
```kconfig
CONFIG_ARM=y
CONFIG_ARCH_S5P6818=y
CONFIG_TARGET_DRONE=y
CONFIG_DEFAULT_DEVICE_TREE="s5p6818-drone"
CONFIG_FIT=y
# CONFIG_CMD_IMI is not set
# CONFIG_CMD_IMLS is not set
# CONFIG_CMD_FLASH is not set
# CONFIG_CMD_FPGA is not set
# CONFIG_CMD_SETEXPR is not set
# CONFIG_CMD_NET is not set
# CONFIG_CMD_NFS is not set
CONFIG_OF_CONTROL=y
CONFIG_OF_EMBED=y
```
