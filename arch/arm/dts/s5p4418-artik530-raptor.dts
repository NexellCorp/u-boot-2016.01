/*
 * (C) Copyright 2016 Nexell
 * Hyunseok, Jung <hsjung@nexell.co.kr>
 *
 * SPDX-License-Identifier:      GPL-2.0+
 */

/dts-v1/;
#include "s5p4418-artik530.dtsi"

/ {
	model = "Samsung artik530 raptor board based on Nexell s5p4418";
	cpu-model = "S5p4418";

	compatible = "samsung,artik530-raptor", "samsung,artik530",
		   "nexell,s5p4418";

	mmc0:mmc@c0062000 {
		frequency = <50000000>;
		nexell,drive_dly = <0x0>;
		nexell,drive_shift = <0x03>;
		nexell,sample_dly = <0x00>;
		nexell,sample_shift = <0x02>;
		status = "okay";
	};
};
