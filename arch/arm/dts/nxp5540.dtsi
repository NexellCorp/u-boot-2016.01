/*
 * (C) Copyright 2016 Nexell
 * Youngbok, Park <park@nexell.co.kr>
 *
 * SPDX-License-Identifier:      GPL-2.0+
 */

#include <dt-bindings/reset/nexell,nxp5540-reset.h>

#include "skeleton.dtsi"
/ {
	nxp5540_rst: reset {
		#reset-cells = <2>;
		compatible = "nexell,nxp5540-reset";
		reg = <PHYS_BASE_SYS_RSTCON 0x800
		       PHYS_BASE_TBUS_RSTCON 0x800
		       PHYS_BASE_LBUS_RSTCON 0x800
		       PHYS_BASE_BBUS_RSTCON 0x800
		       PHYS_BASE_CODA_RSTCON 0x800
		       PHYS_BASE_DISP_RSTCON 0x800
		       PHYS_BASE_USB_RSTCON 0x800
		       PHYS_BASE_HDMI_RSTCON 0x800
		       PHYS_BASE_WAVE_RSTCON 0x800
		       PHYS_BASE_DREX_RSTCON 0x800
		       PHYS_BASE_WAVE420_RSTCON 0x800
		       PHYS_BASE_CPU_RSTCON 0x800
		       PHYS_BASE_PERICLK_RSTCON 0x800>;
	};
};
