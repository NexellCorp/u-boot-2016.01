## arch/arm/mach-s5p6818/Kconfig
```kconfig
if ARCH_S5P6818

menu "Board for S5P6818"
source "board/s5p6818/Kconfig"
endmenu

config SYS_SOC
	default "s5p6818"

endif
```

## board/nexell/common/Kconfig
```kconfig
config ARTIK_OTA
	bool "ARTIK Update feature"
	help
	  This feature provides OTA(Over-The-Air) function.
	  It updates kernel & modules partition without
	  the need of physical access.

config RECOVERY_BOOT
	bool "Nexell Recovery Boot feature"
	help
	  This feature provides Recoveryboot function.
	  Recoveryboot feature is needed by Android recovery boot.
```

## board/nexell/s5p4418/Kconfig
```kconfig
choice
	prompt "Board select"

config TARGET_S5P4418_DRONE
	bool "S5P4418_DRONE"
	help
	  Support for s5p4418 drone platform.

config TARGET_ARTIK530_RAPTOR
        bool "ARTIK530_RAPTOR"
	help
	  Support for artik530_raptor platform.

config TARGET_S5P4418_AVN_REF
	bool "S5P4418_AVN_REF"
	help
	  Support for s5p4418 avn_ref platform.

config TARGET_S5P4418_NAVI_REF
	bool "S5P4418_NAVI_REF"
	help
	  Support for s5p4418 navi_ref platform.

config TARGET_S5P4418_DAUDIO_REF
	bool "S5P4418_DAUDIO_REF"
	help
	  Support for s5p4418 daudio_ref platform.

config TARGET_S5P4418_SMART_VOICE
	bool "S5P4418_SMART_VOICE"
	help
	  Support for s5p4418 smart_voice platform.

config TARGET_S5P4418_FF_VOICE
	bool "S5P4418_FF_VOICE"
	help
	  Support for s5p4418 farfield_voice platform

config TARGET_S5P4418_ZH_DRAGON
	bool "S5P4418_ZH_DRAGON"
	help
	  Support for s5p4418 zonghong dragon platform.

config TARGET_S5P4418_ZH_BLACKDRAGON
	bool "S5P4418_ZH_BLACKDRAGON"
	help
	  Support for s5p4418 zhonghong blackdragon platform.

config TARGET_S5P4418_DAUDIO_COVI
	bool "S5P4418_DAUDIO_COVI"
	help
	  Support for s5p4418 daudio_covi platform.

config TARGET_S5P4418_CLOVA
    bool "S5P4418_CLOVA"
    help
      Support for s5p4418 clova platform

config TARGET_S5P4418_SVM_REF
	bool "S5P4418_SVM_REF"
	help
	  Support for s5p4418 svm_ref platform.

config TARGET_ARTIK305_RAPTOR
        bool "ARTIK305_RAPTOR"
	help
	  Support for artik305_raptor platform.

endchoice

config SYS_VENDOR
	default "nexell"

config SYS_BOARD
	default "s5p4418"

config SYS_CONFIG_NAME
	string "Board header file"
	help
	  This option should contain the base name of board header file.
	  The header file include/configs/<CONFIG_SYS_CONFIG_NAME>.h
	  should be included from include/config.h.

source "board/nexell/common/Kconfig"
```

## board/nexell/s5p4418/zh_blackdragon/Kconfig
```kconfig
if TARGET_S5P4418_ZH_BLACKDRAGON

config SYS_BOARD
	default "zh_blackdragon"

endif
```

## board/s5p4418/Kconfig
```kconfig
choice
	prompt "Board select"

config TARGET_S5P4418_DRONE
	bool "S5P4418_DRONE"
	help
	  Support for s5p4418 drone platform.

config TARGET_ARTIK530_RAPTOR
        bool "ARTIK530_RAPTOR"
	help
	  Support for artik530_raptor platform.

config TARGET_S5P4418_AVN_REF
	bool "S5P4418_AVN_REF"
	help
	  Support for s5p4418 avn_ref platform.

config TARGET_S5P4418_NAVI_REF
	bool "S5P4418_NAVI_REF"
	help
	  Support for s5p4418 navi_ref platform.

config TARGET_S5P4418_BITMINER_REF
	bool "S5P4418_BITMINER_REF"
	help
	  Support for s5p4418 bitminer_ref platform.

config TARGET_S5P4418_DAUDIO_REF
	bool "S5P4418_DAUDIO_REF"
	help
	  Support for s5p4418 daudio_ref platform.

config TARGET_S5P4418_SMART_VOICE
	bool "S5P4418_SMART_VOICE"
	help
	  Support for s5p4418 smart_voice platform.

config TARGET_S5P4418_FF_VOICE
	bool "S5P4418_FF_VOICE"
	help
	  Support for s5p4418 farfield_voice platform

config TARGET_S5P4418_ZH_DRAGON
	bool "S5P4418_ZH_DRAGON"
	help
	  Support for s5p4418 zonghong dragon platform.

config TARGET_S5P4418_ZH_BLACKDRAGON
	bool "S5P4418_ZH_BLACKDRAGON"
	help
	  Support for s5p4418 zhonghong blackdragon platform.

config TARGET_S5P4418_DAUDIO_COVI
	bool "S5P4418_DAUDIO_COVI"
	help
	  Support for s5p4418 daudio_covi platform.

config TARGET_S5P4418_CLOVA
    bool "S5P4418_CLOVA"
    help
      Support for s5p4418 clova platform

config TARGET_S5P4418_SVM_REF
	bool "S5P4418_SVM_REF"
	help
	  Support for s5p4418 svm_ref platform.

config TARGET_S5P4418_DAUDIO_CONA
	bool "S5P4418_DAUDIO_CONA"
	help
	  Support for s5p4418 daudio_cona platform.

config TARGET_S5P4418_CLUSTER_REF
	bool "S5P4418_CLUSTER_REF"
	help
		Support for s5p4418 cluster_ref platform.

config TARGET_S5P4418_ALLO_DISPLAY
	bool "S5P4418_ALLO_DISPLAY"
	help
		Support for s5p4418 allo_display platform.

endchoice
config SYS_VENDOR
	default "s5p4418"

config SYS_CONFIG_NAME
	string "Board header file"
	help
	  This option should contain the base name of board header file.
	  The header file include/configs/<CONFIG_SYS_CONFIG_NAME>.h
	  should be included from include/config.h.

source "board/s5p4418/drone/Kconfig"
source "board/s5p4418/artik530_raptor/Kconfig"
source "board/s5p4418/avn_ref/Kconfig"
source "board/s5p4418/navi_ref/Kconfig"
source "board/s5p4418/bitminer_ref/Kconfig"
source "board/s5p4418/daudio_ref/Kconfig"
source "board/s5p4418/smart_voice/Kconfig"
source "board/s5p4418/ff_voice/Kconfig"
source "board/s5p4418/zh_dragon/Kconfig"
source "board/s5p4418/zh_blackdragon/Kconfig"
source "board/s5p4418/daudio_covi/Kconfig"
source "board/s5p4418/clova/Kconfig"
source "board/s5p4418/svm_ref/Kconfig"
source "board/s5p4418/daudio_cona/Kconfig"
source "board/s5p4418/cluster_ref/Kconfig"
source "board/s5p4418/allo_display/Kconfig"
```

## board/s5p4418/artik530_raptor/Kconfig
```kconfig
if TARGET_ARTIK530_RAPTOR

config SYS_BOARD
	default "artik530_raptor"

config SYS_CONFIG_NAME
	default "artik530_raptor"

endif
```

## board/s5p4418/avn_ref/Kconfig
```kconfig
if TARGET_S5P4418_AVN_REF

config SYS_BOARD
	default "avn_ref"

config SYS_VENDOR
	default "s5p4418"

config SYS_CONFIG_NAME
	default "s5p4418_avn_ref"

config S5P4418_FEATURES
	bool
	default y

endif
```

## board/s5p4418/convergence_svmc/Kconfig
```kconfig
if TARGET_S5P4418_CONVERGENCE_SVMC

config SYS_BOARD
	default "convergence_svmc"

endif
```

## board/s5p4418/drone/Kconfig
```kconfig
if TARGET_S5P4418_DRONE

config SYS_BOARD
	default "drone"

config SYS_CONFIG_NAME
	default "s5p4418_drone"

endif
```

## board/s5p4418/navi_ref/Kconfig
```kconfig
if TARGET_S5P4418_NAVI_REF

config SYS_BOARD
	default "navi_ref"

config SYS_VENDOR
	default "s5p4418"

config SYS_CONFIG_NAME
	default "s5p4418_navi_ref"

config S5P4418_FEATURES
	bool
	default y

endif
```

## board/s5p6818/Kconfig
```kconfig
choice
	prompt "Board select"

config TARGET_S5P6818_DRONE
	bool "S5P6818_DRONE"
	help
	  Support for s5p6818 drone platform.

config TARGET_ARTIK710_RAPTOR
	bool "ARTIK710_RAPTOR"
	help
	  Support for artik710_raptor platform.

config TARGET_AVN_REF
	bool "AVN_REF"
	help
	  Support for S5P6818 avn ref platform.

config TARGET_BITMINER_REF
	bool "BITMINER_REF"
	help
	  Support for S5P6818 bitminer ref platform.

config TARGET_KICK_ST
	bool "KICK_ST"
	help
	  Support for S5P6818 kick st platform.

endchoice

config SYS_VENDOR
	default "s5p6818"

config SYS_CONFIG_NAME
	string "Board header file"
	help
	  This option should contain the base name of board header file.
	  The header file include/configs/<CONFIG_SYS_CONFIG_NAME>.h
	  should be included from include/config.h.

source "board/s5p6818/drone/Kconfig"
source "board/s5p6818/avn_ref/Kconfig"
source "board/s5p6818/bitminer_ref/Kconfig"
source "board/s5p6818/artik710_raptor/Kconfig"
source "board/s5p6818/kick_st/Kconfig"
```

## board/s5p6818/artik710_raptor/Kconfig
```kconfig
if TARGET_ARTIK710_RAPTOR

config SYS_BOARD
	default "artik710_raptor"

config SYS_CONFIG_NAME
	default "artik710_raptor"

endif
```

## board/s5p6818/bitminer_ref/Kconfig
```kconfig
if TARGET_BITMINER_REF

config SYS_BOARD
	default "bitminer_ref"

config SYS_VENDOR
	default "s5p6818"

config SYS_CONFIG_NAME
	default "s5p6818_bitminer_ref"

config S5P6818_FEATURES
	bool
	default y
	select ARM64

endif
```

## board/s5p6818/drone/Kconfig
```kconfig
if TARGET_S5P6818_DRONE

config SYS_BOARD
	default "drone"

config SYS_CONFIG_NAME
	default "s5p6818_drone"

endif
```

## configs/s5p4418_cluster_ref_defconfig
```kconfig
CONFIG_ARM=y
CONFIG_SYS_CONFIG_NAME="s5p4418_cluster_ref"
CONFIG_ARCH_NEXELL=y
CONFIG_ARCH_S5P4418=y
CONFIG_CPU_NXP4330=y
CONFIG_TARGET_S5P4418_CLUSTER_REF=y
CONFIG_DM_GPIO=y
CONFIG_DEFAULT_DEVICE_TREE="s5p4418-cluster-ref"
CONFIG_FIT=y
# CONFIG_CMD_ELF is not set
# CONFIG_CMD_IMI is not set
# CONFIG_CMD_IMLS is not set
# CONFIG_CMD_XIMG is not set
# CONFIG_CMD_CRC32 is not set
# CONFIG_CMD_DM is not set
# CONFIG_CMD_LOADB is not set
# CONFIG_CMD_LOADS is not set
# CONFIG_CMD_FLASH is not set
CONFIG_CMD_USB=y
# CONFIG_CMD_FPGA is not set
CONFIG_CMD_GPIO=y
# CONFIG_CMD_ITEST is not set
# CONFIG_CMD_SETEXPR is not set
# CONFIG_CMD_NET is not set
# CONFIG_CMD_NFS is not set
CONFIG_CMD_FDISK=y
CONFIG_CMD_EXT4_IMG_WRITE=y
CONFIG_OF_CONTROL=y
CONFIG_OF_EMBED=y
CONFIG_DM=y
CONFIG_NX_GPIO=y
CONFIG_USB=y
CONFIG_DM_USB=y
CONFIG_USB_EHCI_HCD=y
CONFIG_USB_STORAGE=y
CONFIG_DISPLAY_PORT=y
CONFIG_VIDEO_NX=y
CONFIG_VIDEO_NX_RGB=y
CONFIG_VIDEO_NX_LVDS=y
CONFIG_ERRNO_STR=y
```

## configs/s5p4418_drone_defconfig
```kconfig
CONFIG_ARM=y
CONFIG_ARCH_NEXELL=y
CONFIG_ARCH_S5P4418=y
CONFIG_DEFAULT_DEVICE_TREE="s5p4418-drone"
CONFIG_FIT=y
# CONFIG_CMD_IMI is not set
# CONFIG_CMD_IMLS is not set
# CONFIG_CMD_FLASH is not set
CONFIG_CMD_USB=y
# CONFIG_CMD_FPGA is not set
# CONFIG_CMD_SETEXPR is not set
# CONFIG_CMD_NET is not set
# CONFIG_CMD_NFS is not set
CONFIG_OF_CONTROL=y
CONFIG_OF_EMBED=y
CONFIG_DM=y
CONFIG_USB=y
CONFIG_DM_USB=y
CONFIG_USB_EHCI_HCD=y
CONFIG_USB_STORAGE=y
```
